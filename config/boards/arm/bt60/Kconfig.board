## config/boards/arm/bt60/Kconfig.board
```kconfig
# BT60 board configuration

# Copyright (c) 2021 Polarity Works
# SPDX-License-Identifier: MIT

config BOARD_BT60
	bool "bt60"
	depends on SOC_NRF52840_QIAA
```

## config/boards/arm/bt60/bt60_defconfig
```kconfig
# SPDX-License-Identifier: MIT

CONFIG_SOC_SERIES_NRF52X=y
CONFIG_SOC_NRF52840_QIAA=y
CONFIG_BOARD_BT60=y

# Enable MPU
CONFIG_ARM_MPU=y

# enable GPIO
CONFIG_GPIO=y

CONFIG_PINCTRL=y

# encoder
CONFIG_EC11=y
CONFIG_EC11_TRIGGER_GLOBAL_THREAD=y

CONFIG_USE_DT_CODE_PARTITION=y

CONFIG_MPU_ALLOW_FLASH_WRITE=y
CONFIG_NVS=y
CONFIG_SETTINGS_NVS=y
CONFIG_FLASH=y
CONFIG_FLASH_PAGE_LAYOUT=y
CONFIG_FLASH_MAP=y

CONFIG_SPI=y
CONFIG_ZMK_RGB_UNDERGLOW=y
CONFIG_ZMK_RGB_UNDERGLOW_EXT_POWER=y
CONFIG_ZMK_RGB_UNDERGLOW_ON_START=y
CONFIG_ZMK_RGB_UNDERGLOW_HUE_STEP=10
CONFIG_ZMK_RGB_UNDERGLOW_SAT_STEP=10
CONFIG_ZMK_RGB_UNDERGLOW_BRT_STEP=10
CONFIG_ZMK_RGB_UNDERGLOW_HUE_START=262
CONFIG_ZMK_RGB_UNDERGLOW_SAT_START=100
CONFIG_ZMK_RGB_UNDERGLOW_BRT_START=100
CONFIG_ZMK_RGB_UNDERGLOW_SPD_START=3
CONFIG_ZMK_RGB_UNDERGLOW_EFF_START=1
CONFIG_ZMK_RGB_UNDERGLOW_BRT_MIN=0
CONFIG_ZMK_RGB_UNDERGLOW_BRT_MAX=100
# Use the STRIP config specific to the LEDs you're using
CONFIG_WS2812_STRIP=y
CONFIG_BT_CTLR_TX_PWR_PLUS_8=y
CONFIG_PWM=y
CONFIG_LED_PWM=y
CONFIG_ZMK_BACKLIGHT=y
CONFIG_BUILD_OUTPUT_UF2=y
```

## config/boards/arm/bt65/Kconfig.board
```kconfig
# BT65 board configuration

# Copyright (c) 2021 Polarity Works
# SPDX-License-Identifier: MIT

config BOARD_BT65
	bool "bt65"
	depends on SOC_NRF52840_QIAA
```

## config/boards/arm/bt65/Kconfig.defconfig
```kconfig
# Copyright (c) 2021 Polarity Works
# SPDX-License-Identifier: MIT

if BOARD_BT65

config BOARD
	default "bt65"

if USB

config USB_NRFX
	default y

config USB_DEVICE_STACK
	default y

endif # USB

config BT_CTLR
	default BT

config ZMK_BLE
	default y

config ZMK_USB
	default y

config ZMK_BATTERY_VOLTAGE_DIVIDER
	default y

config ZMK_KEYBOARD_NAME
	default "BT65"

endif # BOARD_BT65
```

## config/boards/arm/bt75/Kconfig.board
```kconfig
# BT75 board configuration

# Copyright (c) 2021 Polarity Works
# SPDX-License-Identifier: MIT

config BOARD_BT75
	bool "bt75"
	depends on SOC_NRF52840_QIAA
```

## config/boards/arm/bt75/Kconfig.defconfig
```kconfig
# Copyright (c) 2021 Polarity Works
# SPDX-License-Identifier: MIT

if BOARD_BT75

config BOARD
	default "bt75"

if USB

config USB_NRFX
	default y

config USB_DEVICE_STACK
	default y

endif # USB

config BT_CTLR
	default BT

config ZMK_BLE
	default y

config ZMK_USB
	default y

config ZMK_BATTERY_VOLTAGE_DIVIDER
	default y

config ZMK_KEYBOARD_NAME
	default "BT75"

endif # BOARD_BT75
```

## config/west.yml
```yaml
manifest:
  remotes:
    - name: zmkfirmware
      url-base: https://github.com/zmkfirmware
    - name: bortoz
      url-base: https://github.com/bortoz
  projects:
    - name: zmk
      remote: bortoz
      revision: backlight
      import: app/west.yml
  self:
    path: config
```
